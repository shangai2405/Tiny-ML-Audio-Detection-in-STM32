/**
 * ssd1306.c - Lightweight SSD1306 128x64 I2C OLED driver.
 */
#include "ssd1306.h"
#include <string.h>

static uint8_t s_buffer[SSD1306_BUFFER_SIZE];

/* Minimal ASCII 5x7 font (space 0x20 up to '~' 0x7E) */
static const uint8_t font5x7[][5] = {
    {0x00, 0x00, 0x00, 0x00, 0x00}, /* Space */
    {0x00, 0x00, 0x5F, 0x00, 0x00}, /* ! */
    {0x00, 0x07, 0x00, 0x07, 0x00}, /* " */
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    {0x08, 0x08, 0x2A, 0x1C, 0x08}  /* ~ */
};

static void write_cmd(I2C_HandleTypeDef *hi2c, uint8_t cmd)
{
    HAL_I2C_Mem_Write(hi2c, SSD1306_I2C_ADDR, 0x00, 1, &cmd, 1, 10);
}

bool ssd1306_init(I2C_HandleTypeDef *hi2c)
{
    /* Check device presence */
    if (HAL_I2C_IsDeviceReady(hi2c, SSD1306_I2C_ADDR, 2, 50) != HAL_OK) {
        return false;
    }

    /* Standard initialization sequence for 128x64 SSD1306 */
    write_cmd(hi2c, 0xAE); /* Display off */
    write_cmd(hi2c, 0xD5); /* Set display clock divide ratio */
    write_cmd(hi2c, 0x80);
    write_cmd(hi2c, 0xA8); /* Set multiplex ratio (64 lines) */
    write_cmd(hi2c, 0x3F);
    write_cmd(hi2c, 0xD3); /* Display offset = 0 */
    write_cmd(hi2c, 0x00);
    write_cmd(hi2c, 0x40); /* Set start line to 0 */
    write_cmd(hi2c, 0x8D); /* Charge pump */
    write_cmd(hi2c, 0x14); /* Enable charge pump */
    write_cmd(hi2c, 0x20); /* Memory addressing mode */
    write_cmd(hi2c, 0x00); /* Horizontal addressing mode */
    write_cmd(hi2c, 0xA1); /* Segment remap */
    write_cmd(hi2c, 0xC8); /* COM output scan direction reversed */
    write_cmd(hi2c, 0xDA); /* Set COM pins hardware config */
    write_cmd(hi2c, 0x12);
    write_cmd(hi2c, 0x81); /* Set contrast */
    write_cmd(hi2c, 0xCF);
    write_cmd(hi2c, 0xD9); /* Set pre-charge period */
    write_cmd(hi2c, 0xF1);
    write_cmd(hi2c, 0xDB); /* Set VCOMH deselect level */
    write_cmd(hi2c, 0x40);
    write_cmd(hi2c, 0xA4); /* Entire display on (resume to RAM) */
    write_cmd(hi2c, 0xA6); /* Normal display (non-inverted) */
    write_cmd(hi2c, 0xAF); /* Display on */

    ssd1306_clear();
    ssd1306_update(hi2c);
    return true;
}

void ssd1306_clear(void)
{
    memset(s_buffer, 0x00, sizeof(s_buffer));
}

void ssd1306_update(I2C_HandleTypeDef *hi2c)
{
    /* Set column address range 0..127 */
    write_cmd(hi2c, 0x21);
    write_cmd(hi2c, 0);
    write_cmd(hi2c, SSD1306_WIDTH - 1);

    /* Set page address range 0..7 */
    write_cmd(hi2c, 0x22);
    write_cmd(hi2c, 0);
    write_cmd(hi2c, (SSD1306_HEIGHT / 8) - 1);

    /* Write 1024-byte framebuffer in chunks */
    HAL_I2C_Mem_Write(hi2c, SSD1306_I2C_ADDR, 0x40, 1, s_buffer, SSD1306_BUFFER_SIZE, 100);
}

void ssd1306_draw_pixel(int16_t x, int16_t y, ssd1306_color_t color)
{
    if (x < 0 || x >= SSD1306_WIDTH || y < 0 || y >= SSD1306_HEIGHT) return;
    if (color == SSD1306_COLOR_WHITE) {
        s_buffer[x + (y / 8) * SSD1306_WIDTH] |= (1 << (y % 8));
    } else {
        s_buffer[x + (y / 8) * SSD1306_WIDTH] &= ~(1 << (y % 8));
    }
}

void ssd1306_draw_string_small(int16_t x, int16_t y, const char *str, ssd1306_color_t color)
{
    while (*str) {
        char ch = *str++;
        if (ch < 0x20 || ch > 0x7E) ch = '?';
        const uint8_t *glyph = font5x7[ch - 0x20];
        for (int col = 0; col < 5; col++) {
            uint8_t line = glyph[col];
            for (int row = 0; row < 7; row++) {
                if (line & (1 << row)) {
                    ssd1306_draw_pixel(x + col, y + row, color);
                }
            }
        }
        x += 6;
    }
}

void ssd1306_draw_string_scaled(int16_t x, int16_t y, const char *str, uint8_t scale, ssd1306_color_t color)
{
    while (*str) {
        char ch = *str++;
        if (ch < 0x20 || ch > 0x7E) ch = '?';
        const uint8_t *glyph = font5x7[ch - 0x20];
        for (int col = 0; col < 5; col++) {
            uint8_t line = glyph[col];
            for (int row = 0; row < 7; row++) {
                if (line & (1 << row)) {
                    for (int dx = 0; dx < scale; dx++)
                        for (int dy = 0; dy < scale; dy++)
                            ssd1306_draw_pixel(x + scale * col + dx, y + scale * row + dy, color);
                }
            }
        }
        x += 6 * scale;
    }
}

void ssd1306_draw_string_large(int16_t x, int16_t y, const char *str, ssd1306_color_t color)
{
    ssd1306_draw_string_scaled(x, y, str, 2, color);
}

void ssd1306_draw_bar(int16_t x, int16_t y, int16_t w, int16_t h, uint8_t pct)
{
    for (int16_t i = x; i < x + w; i++) {
        ssd1306_draw_pixel(i, y, SSD1306_COLOR_WHITE);
        ssd1306_draw_pixel(i, y + h - 1, SSD1306_COLOR_WHITE);
    }
    for (int16_t j = y; j < y + h; j++) {
        ssd1306_draw_pixel(x, j, SSD1306_COLOR_WHITE);
        ssd1306_draw_pixel(x + w - 1, j, SSD1306_COLOR_WHITE);
    }
    if (pct > 100) pct = 100;
    int16_t fill_w = (int16_t)(((int32_t)(w - 4) * pct) / 100);
    for (int16_t j = y + 2; j < y + h - 2; j++)
        for (int16_t i = x + 2; i < x + 2 + fill_w; i++)
            ssd1306_draw_pixel(i, j, SSD1306_COLOR_WHITE);
}
